## blobs/coreboot/neoverse-n2-uefistub-defconfig
```kconfig
CONFIG_VENDOR_ARM=y
CONFIG_DEFAULT_CONSOLE_LOGLEVEL_8=y
# CONFIG_CONSOLE_USE_LOGLEVEL_PREFIX is not set
# CONFIG_CONSOLE_USE_ANSI_ESCAPES is not set
# CONFIG_GENERATE_SMBIOS_TABLES is not set
# CONFIG_PAYLOAD_NONE is not set
CONFIG_PAYLOAD_FILE="uefistub.elf"
CONFIG_COMPRESSED_PAYLOAD_NONE=y
```

## blobs/coreboot/qemu-sbsa-defconfig
```kconfig
CONFIG_BOARD_EMULATION_QEMU_SBSA=y
CONFIG_CONSOLE_CBMEM_BUFFER_SIZE=0x20000
CONFIG_I2C_TRANSFER_TIMEOUT_US=500000
# CONFIG_PAYLOAD_NONE is not set
CONFIG_PAYLOAD_FILE="u-boot.elf"
CONFIG_DEBUG_ACPICA_COMPATIBLE=y
CONFIG_DEFAULT_CONSOLE_LOGLEVEL_8=y
CONFIG_UPL_FDT_HANDOFF=y
```

## blobs/coreboot/qemu-sbsa-uefistub-defconfig
```kconfig
CONFIG_BOARD_EMULATION_QEMU_SBSA=y
# CONFIG_PAYLOAD_NONE is not set
CONFIG_PAYLOAD_ELF=y
CONFIG_PAYLOAD_FILE="payloads/uefistub/build/uefistub.elf"
```

## blobs/fit/image.its
```
/dts-v1/;

/ {

    description = "Flattened uImage Tree for qemu-sbsa";
    #address-cells = <2>;

    images {

        kernel {

            description = "Linux kernel";
            data = /incbin/("./Image.gz");
            type = "kernel";
            arch = "arm64";
            os = "efi";
            compression = "gzip";
            load = /bits/ 64 <0x10024400000>;
            entry = /bits/ 64 <0x10024400000>;

            hash {

                algo = "sha256";
            };
        };
    };

    configurations {

        default = "conf";

        conf {

            description = "Linux kernel with builtin rootfs";
            kernel = "kernel";

            hash {

                algo = "sha256";
            };
        };
    };
};
```

## blobs/uefistub/qemu-sbsa-defconfig
```kconfig
CONFIG_PAYLOAD_PATH="../../../linux/arch/arm64/boot/Image"
CONFIG_BASE_ADDRESS=0x10023300000
```
